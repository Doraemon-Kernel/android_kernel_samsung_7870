## arch/arm64/configs/exynos7870-ares_defconfig
```kconfig
#
#
# AresKernel
#
# CONFIG_AUDIT is not set
# CONFIG_AUDITSYSCALL is not set
# CONFIG_AUDIT_WATCH is not set
# CONFIG_AUDIT_TREE is not set
# CONFIG_AUDIT_GENERIC is not set
# CONFIG_AUDIT_COMPAT_GENERIC is not set
```
